## fs/samplefs/Kconfig
```kconfig
config SAMPLEFS_FS
	tristate "Samplefs support"
	help
	  Samplefs is a Linux file system for leanrning the basic fs concepts.

	  To compile this file system support as a module, choose M here: the
	  module will be called sample.

	  If unsure, say Y.

config SAMPLEFS_DEBUG
	bool "Samplefs Debugging support"
	depends on SAMPLEFS_FS
	help
	  Say Y here to get an Samplefs build with many debugging features,
	  including ASSERT checks, function wrappers around macros,
	  and extra sanity-checking functions in various code paths.

	  Note that the resulting code will be HUGE and SLOW, and probably
	  not useful unless you are debugging a particular problem.

	  Say N unless you are an Samplefs developer, or you play one on TV.
```
